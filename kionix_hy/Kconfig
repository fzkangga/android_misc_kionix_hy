## kionix_hy/Kconfig
```kconfig
config SENSORS_KIONIX_ACCEL
	tristate "KIONIX_ACCEL"
	depends on I2C=y
	help
	  If you say yes here you get support for the Kionix digital 3-axis
	  accelerometer.
	  This driver can also be built as a module. If so, the module will be
	  called kionix_accel.
```
